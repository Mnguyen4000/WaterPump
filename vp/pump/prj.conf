## CMakeLists.txt
```
# SPDX-License-Identifier: Apache-2.0

cmake_minimum_required(VERSION 3.20.0)
find_package(Zephyr REQUIRED HINTS $ENV{ZEPHYR_BASE})
project(pump)

target_sources(app PRIVATE src/main.c)
target_sources(app PRIVATE src/gpio.c)
```

## prj.conf
```kconfig
CONFIG_GPIO=y
CONFIG_STDOUT_CONSOLE=y
```

## src/main.c
```c
#include "gpio.h"
#include <stdio.h>
#include <zephyr/kernel.h>
#include <zephyr/drivers/gpio.h>

/* 1000 msec = 1 sec */
#define SLEEP_TIME_MS   100
#define PUMP 0
#define VALVE 1

#define MODE PUMP

int main(void)
{
	gpio_init();
	powerLED_off();
	while (1) {
		read_button();
		//powerLED_off();
		//debugLED_off();
		//relay_off();
		k_msleep(SLEEP_TIME_MS);
		//powerLED_on();
		
		read_button();
		//debugLED_on();
		//relay_on();
		k_msleep(SLEEP_TIME_MS);
	}
    return 0;
}
```

## src/gpio.c
```c
#include <stdio.h>
#include <zephyr/kernel.h>
#include <zephyr/drivers/gpio.h>


/* The devicetree node identifier for the "led0" alias. */
#define POWERLED DT_ALIAS(led0)
#define DEBUGLED DT_ALIAS(led1)
#define RELAY DT_ALIAS(led2)
#define RELAY_BUTTON DT_ALIAS(sw1)

// Set LED
static const struct gpio_dt_spec power = GPIO_DT_SPEC_GET(POWERLED, gpios);
static const struct gpio_dt_spec debug = GPIO_DT_SPEC_GET(DEBUGLED, gpios);
static const struct gpio_dt_spec relay = GPIO_DT_SPEC_GET(RELAY, gpios);
static const struct gpio_dt_spec relayButton = GPIO_DT_SPEC_GET_OR(RELAY_BUTTON, gpios, {1});


int gpio_init(void) {
    // Initialising
	if (!gpio_is_ready_dt(&power) || !gpio_is_ready_dt(&debug) 
		|| !gpio_is_ready_dt(&relay) || !gpio_is_ready_dt(&relayButton)) {
		return 1;
	}

	gpio_pin_configure_dt(&power, GPIO_OUTPUT | GPIO_ACTIVE_LOW);
	gpio_pin_configure_dt(&debug, GPIO_OUTPUT | GPIO_ACTIVE_LOW);
	gpio_pin_configure_dt(&relay, GPIO_OUTPUT | GPIO_ACTIVE_LOW);
	gpio_pin_configure_dt(&relayButton, GPIO_INPUT);


	gpio_pin_set_dt(&power, 0);
	gpio_pin_set_dt(&debug, 0);
	gpio_pin_set_dt(&relay, 0);
    return 0;
}


void relay_on(void) {
	gpio_pin_set_dt(&relay, 0);
}

void powerLED_on(void) {
	gpio_pin_set_dt(&power, 0);
}

void debugLED_on(void) {
	gpio_pin_set_dt(&debug, 0);
}

void relay_off(void) {
	gpio_pin_set_dt(&relay, 1);
}

void powerLED_off(void) {
	gpio_pin_set_dt(&power, 1);
}

void debugLED_off(void) {
	gpio_pin_set_dt(&debug, 1);
}


void read_button(void) {
	if (gpio_pin_get_dt(&relayButton)) {
		relay_on();
		//debugLED_on();
	} else {
		relay_off();
		//debugLED_off();
	}
}
```

## src/gpio.h
```c
#ifndef INC_GPIO_H_
#define INC_GPIO_H_

int gpio_init(void);

void relay_on(void);
void powerLED_on(void);
void debugLED_on(void);

void relay_off(void);
void powerLED_off(void);
void debugLED_off(void);

void read_button(void);
#endif
```
