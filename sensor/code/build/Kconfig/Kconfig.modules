## sensor/code/build/Kconfig/Kconfig.modules
```kconfig
menu "acpica (/home/marcus/WaterPump/sensor/modules/lib/acpica)"
osource "$(ZEPHYR_ACPICA_KCONFIG)"
config ZEPHYR_ACPICA_MODULE
	bool
	default y
endmenu
menu "cmsis (/home/marcus/WaterPump/sensor/modules/hal/cmsis)"
osource "$(ZEPHYR_CMSIS_KCONFIG)"
config ZEPHYR_CMSIS_MODULE
	bool
	default y
endmenu
menu "cmsis-dsp (/home/marcus/WaterPump/sensor/modules/lib/cmsis-dsp)"
osource "$(ZEPHYR_CMSIS_DSP_KCONFIG)"
config ZEPHYR_CMSIS_DSP_MODULE
	bool
	default y
endmenu
menu "cmsis-nn (/home/marcus/WaterPump/sensor/modules/lib/cmsis-nn)"
osource "$(ZEPHYR_CMSIS_NN_KCONFIG)"
config ZEPHYR_CMSIS_NN_MODULE
	bool
	default y
endmenu
menu "fatfs (/home/marcus/WaterPump/sensor/modules/fs/fatfs)"
osource "$(ZEPHYR_FATFS_KCONFIG)"
config ZEPHYR_FATFS_MODULE
	bool
	default y
endmenu
config ZEPHYR_ADI_MODULE
   bool
   default y
config ZEPHYR_ALTERA_MODULE
   bool
   default y
menu "hal_ambiq (/home/marcus/WaterPump/sensor/modules/hal/ambiq)"
osource "$(ZEPHYR_HAL_AMBIQ_KCONFIG)"
config ZEPHYR_HAL_AMBIQ_MODULE
	bool
	default y
endmenu
config ZEPHYR_ATMEL_MODULE
   bool
   default y
menu "hal_espressif (/home/marcus/WaterPump/sensor/modules/hal/espressif)"
osource "/home/marcus/WaterPump/sensor/modules/hal/espressif/zephyr/Kconfig"
config ZEPHYR_HAL_ESPRESSIF_MODULE
	bool
	default y
	select TAINT_BLOBS
endmenu
menu "hal_ethos_u (/home/marcus/WaterPump/sensor/modules/hal/ethos_u)"
osource "$(ZEPHYR_HAL_ETHOS_U_KCONFIG)"
config ZEPHYR_HAL_ETHOS_U_MODULE
	bool
	default y
endmenu
menu "hal_gigadevice (/home/marcus/WaterPump/sensor/modules/hal/gigadevice)"
osource "$(ZEPHYR_HAL_GIGADEVICE_KCONFIG)"
config ZEPHYR_HAL_GIGADEVICE_MODULE
	bool
	default y
endmenu
menu "hal_infineon (/home/marcus/WaterPump/sensor/modules/hal/infineon)"
osource "$(ZEPHYR_HAL_INFINEON_KCONFIG)"
config ZEPHYR_HAL_INFINEON_MODULE
	bool
	default y
endmenu
menu "hal_intel (/home/marcus/WaterPump/sensor/modules/hal/intel)"
osource "/home/marcus/WaterPump/sensor/modules/hal/intel/zephyr/Kconfig"
config ZEPHYR_HAL_INTEL_MODULE
	bool
	default y
endmenu
config ZEPHYR_MICROCHIP_MODULE
   bool
   default y
menu "hal_nordic (/home/marcus/WaterPump/sensor/modules/hal/nordic)"
osource "$(ZEPHYR_HAL_NORDIC_KCONFIG)"
config ZEPHYR_HAL_NORDIC_MODULE
	bool
	default y
endmenu
config ZEPHYR_NUVOTON_MODULE
   bool
   default y
menu "hal_nxp (/home/marcus/WaterPump/sensor/modules/hal/nxp)"
osource "$(ZEPHYR_HAL_NXP_KCONFIG)"
config ZEPHYR_HAL_NXP_MODULE
	bool
	default y
endmenu
config ZEPHYR_OPENISA_MODULE
   bool
   default y
config ZEPHYR_QUICKLOGIC_MODULE
   bool
   default y
config ZEPHYR_HAL_RENESAS_MODULE
   bool
   default y
menu "hal_rpi_pico (/home/marcus/WaterPump/sensor/modules/hal/rpi_pico)"
osource "$(ZEPHYR_HAL_RPI_PICO_KCONFIG)"
config ZEPHYR_HAL_RPI_PICO_MODULE
	bool
	default y
endmenu
menu "hal_silabs (/home/marcus/WaterPump/sensor/modules/hal/silabs)"
osource "/home/marcus/WaterPump/sensor/modules/hal/silabs/zephyr/Kconfig"
config ZEPHYR_HAL_SILABS_MODULE
	bool
	default y
endmenu
menu "hal_st (/home/marcus/WaterPump/sensor/modules/hal/st)"
osource "$(ZEPHYR_HAL_ST_KCONFIG)"
config ZEPHYR_HAL_ST_MODULE
	bool
	default y
endmenu
config ZEPHYR_STM32_MODULE
   bool
   default y
menu "hal_telink (/home/marcus/WaterPump/sensor/modules/hal/telink)"
osource "/home/marcus/WaterPump/sensor/modules/hal/telink/Kconfig"
config ZEPHYR_HAL_TELINK_MODULE
	bool
	default y
endmenu
config ZEPHYR_TI_MODULE
   bool
   default y
config ZEPHYR_HAL_WURTHELEKTRONIK_MODULE
   bool
   default y
config ZEPHYR_XTENSA_MODULE
   bool
   default y
menu "hostap (/home/marcus/WaterPump/sensor/modules/lib/hostap)"
osource "$(ZEPHYR_HOSTAP_KCONFIG)"
config ZEPHYR_HOSTAP_MODULE
	bool
	default y
endmenu
config ZEPHYR_LIBMETAL_MODULE
   bool
   default y
menu "liblc3 (/home/marcus/WaterPump/sensor/modules/lib/liblc3)"
osource "$(ZEPHYR_LIBLC3_KCONFIG)"
config ZEPHYR_LIBLC3_MODULE
	bool
	default y
endmenu
menu "littlefs (/home/marcus/WaterPump/sensor/modules/fs/littlefs)"
osource "$(ZEPHYR_LITTLEFS_KCONFIG)"
config ZEPHYR_LITTLEFS_MODULE
	bool
	default y
endmenu
menu "loramac-node (/home/marcus/WaterPump/sensor/modules/lib/loramac-node)"
osource "$(ZEPHYR_LORAMAC_NODE_KCONFIG)"
config ZEPHYR_LORAMAC_NODE_MODULE
	bool
	default y
endmenu
menu "lvgl (/home/marcus/WaterPump/sensor/modules/lib/gui/lvgl)"
osource "/home/marcus/WaterPump/sensor/modules/lib/gui/lvgl/Kconfig"
config ZEPHYR_LVGL_MODULE
	bool
	default y
endmenu
menu "mbedtls (/home/marcus/WaterPump/sensor/modules/crypto/mbedtls)"
osource "$(ZEPHYR_MBEDTLS_KCONFIG)"
config ZEPHYR_MBEDTLS_MODULE
	bool
	default y
endmenu
config ZEPHYR_MCUBOOT_MODULE
   bool
   default y
config ZEPHYR_MIPI_SYS_T_MODULE
   bool
   default y
config ZEPHYR_NRF_HW_MODELS_MODULE
   bool
   default y
config ZEPHYR_OPEN_AMP_MODULE
   bool
   default y
menu "openthread (/home/marcus/WaterPump/sensor/modules/lib/openthread)"
osource "$(ZEPHYR_OPENTHREAD_KCONFIG)"
config ZEPHYR_OPENTHREAD_MODULE
	bool
	default y
endmenu
menu "percepio (/home/marcus/WaterPump/sensor/modules/debug/percepio)"
osource "/home/marcus/WaterPump/sensor/modules/debug/percepio/zephyr/Kconfig"
config ZEPHYR_PERCEPIO_MODULE
	bool
	default y
endmenu
menu "picolibc (/home/marcus/WaterPump/sensor/modules/lib/picolibc)"
osource "/home/marcus/WaterPump/sensor/modules/lib/picolibc/zephyr/Kconfig"
config ZEPHYR_PICOLIBC_MODULE
	bool
	default y
endmenu
menu "segger (/home/marcus/WaterPump/sensor/modules/debug/segger)"
osource "$(ZEPHYR_SEGGER_KCONFIG)"
config ZEPHYR_SEGGER_MODULE
	bool
	default y
endmenu
config ZEPHYR_TINYCRYPT_MODULE
   bool
   default y
menu "trusted-firmware-m (/home/marcus/WaterPump/sensor/modules/tee/tf-m/trusted-firmware-m)"
osource "$(ZEPHYR_TRUSTED_FIRMWARE_M_KCONFIG)"
config ZEPHYR_TRUSTED_FIRMWARE_M_MODULE
	bool
	default y
endmenu
menu "trusted-firmware-a (/home/marcus/WaterPump/sensor/modules/tee/tf-a/trusted-firmware-a)"
osource "$(ZEPHYR_TRUSTED_FIRMWARE_A_KCONFIG)"
config ZEPHYR_TRUSTED_FIRMWARE_A_MODULE
	bool
	default y
endmenu
menu "uoscore-uedhoc (/home/marcus/WaterPump/sensor/modules/lib/uoscore-uedhoc)"
osource "$(ZEPHYR_UOSCORE_UEDHOC_KCONFIG)"
config ZEPHYR_UOSCORE_UEDHOC_MODULE
	bool
	default y
endmenu
menu "zcbor (/home/marcus/WaterPump/sensor/modules/lib/zcbor)"
osource "$(ZEPHYR_ZCBOR_KCONFIG)"
config ZEPHYR_ZCBOR_MODULE
	bool
	default y
endmenu
```

## sensor/code/build/Kconfig/arch/Kconfig
```kconfig
# Load arch Kconfig descriptions.
osource "/home/marcus/WaterPump/sensor/zephyr/arch/x86/Kconfig"
osource "/home/marcus/WaterPump/sensor/zephyr/arch/xtensa/Kconfig"
osource "/home/marcus/WaterPump/sensor/zephyr/arch/sparc/Kconfig"
osource "/home/marcus/WaterPump/sensor/zephyr/arch/riscv/Kconfig"
osource "/home/marcus/WaterPump/sensor/zephyr/arch/posix/Kconfig"
osource "/home/marcus/WaterPump/sensor/zephyr/arch/nios2/Kconfig"
osource "/home/marcus/WaterPump/sensor/zephyr/arch/mips/Kconfig"
osource "/home/marcus/WaterPump/sensor/zephyr/arch/arm64/Kconfig"
osource "/home/marcus/WaterPump/sensor/zephyr/arch/arm/Kconfig"
osource "/home/marcus/WaterPump/sensor/zephyr/arch/arc/Kconfig"
```

## vp/pump/build/Kconfig/arch/Kconfig
```kconfig
# Load arch Kconfig descriptions.
osource "/home/marcus/WaterPump/pump/zephyr/arch/x86/Kconfig"
osource "/home/marcus/WaterPump/pump/zephyr/arch/xtensa/Kconfig"
osource "/home/marcus/WaterPump/pump/zephyr/arch/sparc/Kconfig"
osource "/home/marcus/WaterPump/pump/zephyr/arch/riscv/Kconfig"
osource "/home/marcus/WaterPump/pump/zephyr/arch/posix/Kconfig"
osource "/home/marcus/WaterPump/pump/zephyr/arch/nios2/Kconfig"
osource "/home/marcus/WaterPump/pump/zephyr/arch/mips/Kconfig"
osource "/home/marcus/WaterPump/pump/zephyr/arch/arm64/Kconfig"
osource "/home/marcus/WaterPump/pump/zephyr/arch/arm/Kconfig"
osource "/home/marcus/WaterPump/pump/zephyr/arch/arc/Kconfig"
```

## vp/pump/build/Kconfig/soc/Kconfig
```kconfig
# Load Zephyr SoC Kconfig descriptions.
osource "/home/marcus/WaterPump/pump/zephyr/soc/xlnx/zynqmp/Kconfig"
osource "/home/marcus/WaterPump/pump/zephyr/soc/xlnx/zynq7000/Kconfig"
osource "/home/marcus/WaterPump/pump/zephyr/soc/xen/Kconfig"
osource "/home/marcus/WaterPump/pump/zephyr/soc/ti/simplelink/Kconfig"
osource "/home/marcus/WaterPump/pump/zephyr/soc/ti/lm3s6965/Kconfig"
osource "/home/marcus/WaterPump/pump/zephyr/soc/ti/k3/Kconfig"
osource "/home/marcus/WaterPump/pump/zephyr/soc/telink/tlsr/Kconfig"
osource "/home/marcus/WaterPump/pump/zephyr/soc/starfive/jh71xx/Kconfig"
osource "/home/marcus/WaterPump/pump/zephyr/soc/st/stm32/Kconfig"
osource "/home/marcus/WaterPump/pump/zephyr/soc/snps/qemu_arc/Kconfig"
osource "/home/marcus/WaterPump/pump/zephyr/soc/snps/nsim/arc_v/Kconfig"
osource "/home/marcus/WaterPump/pump/zephyr/soc/snps/nsim/arc_classic/Kconfig"
osource "/home/marcus/WaterPump/pump/zephyr/soc/snps/hsdk4xd/Kconfig"
osource "/home/marcus/WaterPump/pump/zephyr/soc/snps/hsdk/Kconfig"
osource "/home/marcus/WaterPump/pump/zephyr/soc/snps/emsk/Kconfig"
osource "/home/marcus/WaterPump/pump/zephyr/soc/snps/emsdp/Kconfig"
osource "/home/marcus/WaterPump/pump/zephyr/soc/snps/arc_iot/Kconfig"
osource "/home/marcus/WaterPump/pump/zephyr/soc/silabs/Kconfig"
osource "/home/marcus/WaterPump/pump/zephyr/soc/sifive/sifive_freedom/Kconfig"
osource "/home/marcus/WaterPump/pump/zephyr/soc/rockchip/Kconfig"
osource "/home/marcus/WaterPump/pump/zephyr/soc/renode/riscv_virtual/Kconfig"
osource "/home/marcus/WaterPump/pump/zephyr/soc/renesas/smartbond/Kconfig"
osource "/home/marcus/WaterPump/pump/zephyr/soc/renesas/rzt2m/Kconfig"
osource "/home/marcus/WaterPump/pump/zephyr/soc/renesas/rcar/Kconfig"
osource "/home/marcus/WaterPump/pump/zephyr/soc/renesas/ra/Kconfig"
osource "/home/marcus/WaterPump/pump/zephyr/soc/raspberrypi/Kconfig"
osource "/home/marcus/WaterPump/pump/zephyr/soc/quicklogic/eos_s3/Kconfig"
osource "/home/marcus/WaterPump/pump/zephyr/soc/qemu/virt_riscv/Kconfig"
osource "/home/marcus/WaterPump/pump/zephyr/soc/qemu/malta/Kconfig"
osource "/home/marcus/WaterPump/pump/zephyr/soc/openisa/rv32m1/Kconfig"
osource "/home/marcus/WaterPump/pump/zephyr/soc/nxp/s32/Kconfig"
osource "/home/marcus/WaterPump/pump/zephyr/soc/nxp/rw/Kconfig"
osource "/home/marcus/WaterPump/pump/zephyr/soc/nxp/mcx/Kconfig"
osource "/home/marcus/WaterPump/pump/zephyr/soc/nxp/lpc/Kconfig"
osource "/home/marcus/WaterPump/pump/zephyr/soc/nxp/layerscape/Kconfig"
osource "/home/marcus/WaterPump/pump/zephyr/soc/nxp/kinetis/Kconfig"
osource "/home/marcus/WaterPump/pump/zephyr/soc/nxp/imxrt/Kconfig"
osource "/home/marcus/WaterPump/pump/zephyr/soc/nxp/imx/Kconfig"
osource "/home/marcus/WaterPump/pump/zephyr/soc/nuvoton/numicro/Kconfig"
osource "/home/marcus/WaterPump/pump/zephyr/soc/nuvoton/numaker/Kconfig"
osource "/home/marcus/WaterPump/pump/zephyr/soc/nuvoton/npcx/Kconfig"
osource "/home/marcus/WaterPump/pump/zephyr/soc/nuvoton/npcm/Kconfig"
osource "/home/marcus/WaterPump/pump/zephyr/soc/nordic/Kconfig"
osource "/home/marcus/WaterPump/pump/zephyr/soc/neorv32/Kconfig"
osource "/home/marcus/WaterPump/pump/zephyr/soc/native/inf_clock/Kconfig"
osource "/home/marcus/WaterPump/pump/zephyr/soc/microchip/miv/Kconfig"
osource "/home/marcus/WaterPump/pump/zephyr/soc/microchip/mec/Kconfig"
osource "/home/marcus/WaterPump/pump/zephyr/soc/mediatek/mtk_adsp/Kconfig"
osource "/home/marcus/WaterPump/pump/zephyr/soc/lowrisc/opentitan/Kconfig"
osource "/home/marcus/WaterPump/pump/zephyr/soc/litex/litex_vexriscv/Kconfig"
osource "/home/marcus/WaterPump/pump/zephyr/soc/ite/ec/Kconfig"
osource "/home/marcus/WaterPump/pump/zephyr/soc/intel/raptor_lake/Kconfig"
osource "/home/marcus/WaterPump/pump/zephyr/soc/intel/lakemont/Kconfig"
osource "/home/marcus/WaterPump/pump/zephyr/soc/intel/intel_socfpga_std/Kconfig"
osource "/home/marcus/WaterPump/pump/zephyr/soc/intel/intel_socfpga/Kconfig"
osource "/home/marcus/WaterPump/pump/zephyr/soc/intel/intel_niosv/Kconfig"
osource "/home/marcus/WaterPump/pump/zephyr/soc/intel/intel_ish/Kconfig"
osource "/home/marcus/WaterPump/pump/zephyr/soc/intel/intel_adsp/Kconfig"
osource "/home/marcus/WaterPump/pump/zephyr/soc/intel/elkhart_lake/Kconfig"
osource "/home/marcus/WaterPump/pump/zephyr/soc/intel/atom/Kconfig"
osource "/home/marcus/WaterPump/pump/zephyr/soc/intel/apollo_lake/Kconfig"
osource "/home/marcus/WaterPump/pump/zephyr/soc/intel/alder_lake/Kconfig"
osource "/home/marcus/WaterPump/pump/zephyr/soc/infineon/cat3/Kconfig"
osource "/home/marcus/WaterPump/pump/zephyr/soc/infineon/cat1b/Kconfig"
osource "/home/marcus/WaterPump/pump/zephyr/soc/infineon/cat1a/Kconfig"
osource "/home/marcus/WaterPump/pump/zephyr/soc/gd/gd32/Kconfig"
osource "/home/marcus/WaterPump/pump/zephyr/soc/gaisler/leon3/Kconfig"
osource "/home/marcus/WaterPump/pump/zephyr/soc/gaisler/gr716a/Kconfig"
osource "/home/marcus/WaterPump/pump/zephyr/soc/espressif/Kconfig"
osource "/home/marcus/WaterPump/pump/zephyr/soc/ene/kb1200/Kconfig"
osource "/home/marcus/WaterPump/pump/zephyr/soc/efinix/sapphire/Kconfig"
osource "/home/marcus/WaterPump/pump/zephyr/soc/cdns/xtensa_sample_controller/Kconfig"
osource "/home/marcus/WaterPump/pump/zephyr/soc/cdns/dc233c/Kconfig"
osource "/home/marcus/WaterPump/pump/zephyr/soc/brcm/bcmvk/Kconfig"
osource "/home/marcus/WaterPump/pump/zephyr/soc/brcm/bcm2712/Kconfig"
osource "/home/marcus/WaterPump/pump/zephyr/soc/brcm/bcm2711/Kconfig"
osource "/home/marcus/WaterPump/pump/zephyr/soc/atmel/sam0/Kconfig"
osource "/home/marcus/WaterPump/pump/zephyr/soc/atmel/sam/Kconfig"
osource "/home/marcus/WaterPump/pump/zephyr/soc/aspeed/Kconfig"
osource "/home/marcus/WaterPump/pump/zephyr/soc/arm/Kconfig"
osource "/home/marcus/WaterPump/pump/zephyr/soc/arm/beetle/Kconfig"
osource "/home/marcus/WaterPump/pump/zephyr/soc/andestech/Kconfig"
osource "/home/marcus/WaterPump/pump/zephyr/soc/ambiq/Kconfig"
osource "/home/marcus/WaterPump/pump/zephyr/soc/altr/zephyr_nios2f/Kconfig"
osource "/home/marcus/WaterPump/pump/zephyr/soc/altr/qemu_nios2/Kconfig"
osource "/home/marcus/WaterPump/pump/zephyr/soc/adi/max32/Kconfig"
```
